## v2/sdkconfig.defaults
```kconfig
# DaiSpan v2 - ESP32-C3 sdkconfig defaults

# Target
CONFIG_IDF_TARGET="esp32c3"

# Flash - reduce SPI speed to lower boot power consumption
CONFIG_ESPTOOLPY_FLASHSIZE_4MB=y
CONFIG_ESPTOOLPY_FLASHFREQ_40M=y

# Partition table
CONFIG_PARTITION_TABLE_CUSTOM=y
CONFIG_PARTITION_TABLE_CUSTOM_FILENAME="partitions.csv"

# FreeRTOS
CONFIG_FREERTOS_HZ=1000
CONFIG_FREERTOS_UNICORE=y

# UART
CONFIG_ESP_CONSOLE_UART_BAUDRATE=115200

# Task stack sizes
CONFIG_ESP_MAIN_TASK_STACK_SIZE=8192
CONFIG_ESP_WIFI_TASK_STACK_SIZE=4096

# NVS
CONFIG_NVS_ENCRYPTION=n

# WiFi
CONFIG_ESP_WIFI_ENABLED=y
CONFIG_ESP_WIFI_STATIC_RX_BUFFER_NUM=6
CONFIG_ESP_WIFI_DYNAMIC_RX_BUFFER_NUM=12
CONFIG_ESP_WIFI_DYNAMIC_TX_BUFFER_NUM=6

# LWIP - increase sockets for HAP + Web server
CONFIG_LWIP_MAX_SOCKETS=16

# mDNS
CONFIG_MDNS_MAX_SERVICES=5

# Disable BLE to save flash
CONFIG_BT_ENABLED=n

# HAP (HomeKit Accessory Protocol)
CONFIG_HAP_MFI_TYPE_NONE=y

# Optimization
CONFIG_COMPILER_OPTIMIZATION_SIZE=y

# Watchdog
CONFIG_ESP_TASK_WDT_TIMEOUT_S=10

# Brownout detector - disabled (false triggers on C3 SuperMini)
CONFIG_ESP_BROWNOUT_DET=n

# Log level
CONFIG_LOG_DEFAULT_LEVEL=3
CONFIG_LOG_MAXIMUM_LEVEL=4
```

## v3/sdkconfig.defaults
```kconfig
# DaiSpan v3 ESP-IDF configuration
CONFIG_IDF_TARGET="esp32c3"

# Partition table
CONFIG_PARTITION_TABLE_CUSTOM=y
CONFIG_PARTITION_TABLE_CUSTOM_FILENAME="partitions.csv"

# Bluetooth (required for Matter BLE commissioning)
CONFIG_BT_ENABLED=y
CONFIG_BT_BLUEDROID_ENABLED=y
CONFIG_BT_BLE_ENABLED=y
CONFIG_BT_CLASSIC_ENABLED=n
CONFIG_BTDM_CTRL_MODE_BLE_ONLY=y
CONFIG_BTDM_CTRL_MODE_BR_EDR_ONLY=n
CONFIG_BTDM_CTRL_MODE_BTDM=n
CONFIG_BT_A2DP_ENABLE=n
CONFIG_BT_BLE_42_FEATURES_SUPPORTED=y
CONFIG_BT_BLE_50_FEATURES_SUPPORTED=n
CONFIG_BT_BLE_DYNAMIC_ENV_MEMORY=y
CONFIG_BT_BTC_TASK_STACK_SIZE=15000

# WiFi/BLE coexistence
CONFIG_ESP_COEX_SW_COEXIST_ENABLE=y

# WiFi softAP
CONFIG_ESP_WIFI_SOFTAP_SUPPORT=y

# WiFi
CONFIG_ESP_WIFI_STATIC_RX_BUFFER_NUM=6
CONFIG_ESP_WIFI_DYNAMIC_RX_BUFFER_NUM=12
CONFIG_ESP_WIFI_DYNAMIC_TX_BUFFER_NUM=6

# LWIP
CONFIG_LWIP_MAX_SOCKETS=16

# mDNS
CONFIG_MDNS_MAX_SERVICES=5

# Flash size
CONFIG_ESPTOOLPY_FLASHSIZE_4MB=y

# Log level
CONFIG_LOG_DEFAULT_LEVEL_INFO=y

# FreeRTOS
CONFIG_FREERTOS_HZ=1000
CONFIG_FREERTOS_IDLE_TASK_STACKSIZE=4096
CONFIG_ESP_SYSTEM_EVENT_TASK_STACK_SIZE=4096
```
